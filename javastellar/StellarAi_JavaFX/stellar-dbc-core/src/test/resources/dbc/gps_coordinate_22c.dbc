VERSION ""

NS_ :

BS_:

BU_: TBOX IVI

BO_ 556 GPS_COORDINATE_22C: 8 TBOX
 SG_ GPS_LONG_INFO : 39|32@0- (1E-007,0) [-214.7484|214.7483646] ""  IVI
 SG_ GPS_LAT_INFO : 7|32@0- (1E-007,0) [-214.7484|214.7483646] "Decimal Degrees"  IVI
